## ESP32-C6-heart-idf/Kconfig.projbuild
```kconfig
menu "Polysom Application"

    config POLYSOM_WIFI_SSID
        string "Wi-Fi SSID"
        default "TNCAP26203D"
        help
            SSID of the network to connect to for NTP time sync.

    config POLYSOM_WIFI_PASSWORD
        string "Wi-Fi password"
        default ""
        help
            Password for the Wi-Fi network.

    config POLYSOM_NTP_SERVER
        string "NTP server"
        default "pool.ntp.org"
        help
            Hostname of the NTP server used for real-time clock sync.

endmenu

menu "Board Configuration"

    config POLYSOM_I2C_SDA_PIN
        int "I2C SDA pin"
        default 6
        help
            GPIO pin number for the shared I2C SDA line.

    config POLYSOM_I2C_SCL_PIN
        int "I2C SCL pin"
        default 7
        help
            GPIO pin number for the shared I2C SCL line.

    config POLYSOM_I2C_FREQ_HZ
        int "I2C bus frequency (Hz)"
        default 400000

    config POLYSOM_MMA_ADDR_0
        hex "MMA8451 I2C address (SA0=GND)"
        default 0x1C

    config POLYSOM_MMA_ADDR_1
        hex "MMA8451 I2C address (SA0=VCC)"
        default 0x1D

    config POLYSOM_LDC_ADDR
        hex "LDC1612 I2C address"
        default 0x2B

    config POLYSOM_SDP800_ADDR
        hex "SDP800 I2C address"
        default 0x25

    config POLYSOM_ECG_ADC_CHANNEL
        int "ECG ADC channel number"
        default 1
        help
            ADC1 channel for the ECG signal. GPIO1 = channel 1 on ESP32-C6.

    config POLYSOM_SPI_MOSI_PIN
        int "SPI MOSI pin"
        default 6

    config POLYSOM_SPI_MISO_PIN
        int "SPI MISO pin"
        default 12

    config POLYSOM_SPI_CLK_PIN
        int "SPI CLK pin"
        default 7

    config POLYSOM_LCD_CS_PIN
        int "LCD CS pin"
        default 14

    config POLYSOM_LCD_DC_PIN
        int "LCD DC pin"
        default 15

    config POLYSOM_LCD_RST_PIN
        int "LCD RST pin"
        default 21

    config POLYSOM_LCD_BL_PIN
        int "LCD backlight pin"
        default 22

    config POLYSOM_LCD_W
        int "LCD width (pixels)"
        default 172

    config POLYSOM_LCD_H
        int "LCD height (pixels)"
        default 320

    config POLYSOM_LCD_SPI_FREQ_HZ
        int "LCD SPI frequency (Hz)"
        default 12000000

    config POLYSOM_SD_CS_PIN
        int "SD card CS pin"
        default 10

    config POLYSOM_SD_SPI_FREQ_HZ
        int "SD card SPI frequency (Hz)"
        default 20000000

    config POLYSOM_ECG_RATE_HZ
        int "ECG sample rate (Hz)"
        default 100

    config POLYSOM_SENSOR_RATE_HZ
        int "Sensor sample rate (Hz)"
        default 50

    config POLYSOM_DISPLAY_RATE_HZ
        int "Display refresh rate (Hz)"
        default 5

    config POLYSOM_LOG_RATE_MS
        int "Logger period (ms)"
        default 20

    config POLYSOM_DISPLAY_RATE_MS
        int "Display refresh period (ms)"
        default 200

    config POLYSOM_BLE_RESCAN_MS
        int "BLE rescan interval (ms)"
        default 10000

    config POLYSOM_MAX_SCAN_RETRIES
        int "Maximum BLE scan retries before deep sleep"
        default 10

    config POLYSOM_SLEEP_DURATION_MINS
        int "Deep sleep duration (minutes)"
        default 10

endmenu
```

## ESP32-C6-heart-idf/main/Kconfig.projbuild
```kconfig
menu "Polysom Application"

    config POLYSOM_TIME_SYNC_TIMEOUT_MS
        int "Serial time-sync timeout (ms)"
        default 30000
        help
            How long to wait at boot for a binary time-sync command on the
            console UART (115200 baud) before giving up and continuing
            without a synced clock. Only used when no DS3231 RTC is fitted
            or its time hasn't been set yet. See components/time_sync and
            tools/set_time.py.

endmenu
```
